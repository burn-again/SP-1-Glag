## CMakeLists.txt
```
cmake_minimum_required(VERSION 3.20.0)

# Glag for the SP-1: Wakes' board, power, watchdog, standby, battery, controls, LEDs and audio
# bring-up (src/sp1_*, from Worldwave/Wakes, MIT), with the Glag engine and controls (../glag)
# as the audio source. See ../README.md.
#
# No ccache, as in Wakes (it once mixed object layouts across header overrides).
set(USE_CCACHE 0 CACHE STRING "Never ccache" FORCE)

find_package(Zephyr REQUIRED HINTS $ENV{ZEPHYR_BASE})
project(glag-sp1)

target_sources(app PRIVATE
	src/main.c
	src/sp1_led.c
	src/sp1_power.c
	src/sp1_batt.c
	src/sp1_standby.c
	src/sp1_console.c
	src/sp1_logbuf.c
	src/sp1_logring.c
	src/sp1_threads.c
	src/sp1_usbd.c
	src/sp1_controls.c
	src/sp1_display.c
	src/sp1_calib.c
	src/sp1_audio.c
	src/sp1_meter.c
	src/sp1_playrow.c
)
target_include_directories(app PRIVATE src)

if(CONFIG_SP1_GLAG)
	# The engine runs in the audio thread: its own library, so it gets -O2 while the rest
	# of the firmware stays -Os. -ffp-contract=off: on the Cortex-M4 a fused multiply-add
	# takes 3 cycles and a separate multiply and add 2 (measured in ../host/cpu).
	set(GLAG ${CMAKE_CURRENT_SOURCE_DIR}/../glag)
	zephyr_library_named(glag)
	zephyr_library_sources(${GLAG}/glag_engine.c ${GLAG}/glag_ui.c)
	zephyr_library_include_directories(${GLAG})
	zephyr_library_compile_options(-O2 -ffp-contract=off -Wdouble-promotion)
	if(CONFIG_SP1_GLAG_NOIR_TEST)
		# the noir album as the CPU test: the audition pieces, Haze on the echo's tape, no script
		zephyr_library_compile_definitions(GL_PROF GL_DEMO_PIECES GL_NO_HAZE_RAM GL_NOIR_TEST GL_TEST_HOOKS)
		target_compile_definitions(app PRIVATE GL_PROF GL_DEMO_PIECES GL_NO_HAZE_RAM GL_NOIR_TEST GL_TEST_HOOKS)
	elseif(CONFIG_SP1_GLAG_CPU_TEST)
		# its parts timed and its output checked; the four heaviest pieces as 17-20; the
		# controls' test hooks for the scenario script (glag_test.h, run from main.c)
		zephyr_library_compile_definitions(GL_PROF GL_TEST_PIECES GL_TEST_HOOKS)
		target_compile_definitions(app PRIVATE GL_PROF GL_TEST_PIECES GL_TEST_HOOKS)   # (main and glag_ui agree)
	endif()
	if(DEFINED GLAG_DEFS)   # audition builds: -DGLAG_DEFS=PULSE_SOFT (engine options, glag_engine.c)
		zephyr_library_compile_definitions(${GLAG_DEFS})
	endif()
	target_link_libraries(app PRIVATE glag)
	target_include_directories(app PRIVATE ${GLAG})
endif()
```

## Kconfig
```
# Glag application Kconfig: Wakes' (wakes-sp1) board, power and audio base with the Glag
# engine as the audio source. Wakes' options are kept so its code builds unchanged.

menu "glag-sp1"

# ---- the USB device's identity (M5a, src/sp1_usbd.c) ----
# Through M4e the console came up through Zephyr's sample helper, which hard-codes Zephyr's
# shared test vendor ID. These are ours. ⚠️ Change the PID whenever the set of USB functions
# changes (M5a added MIDI): hosts cache descriptors by VID/PID.
config SP1_USB_VID
	hex "USB vendor ID"
	default 0x2fe3
	help
	  0x2fe3 is Zephyr's test vendor ID, kept only until pid.codes (VID 0x1209,
	  free product IDs for open-source projects) grants Wakes a PID of its own.

config SP1_USB_PID
	hex "USB product ID"
	default 0x5217
	help
	  Glag: console only, so a PID of its own (hosts cache descriptors by VID/PID).
	  Wakes' history, for reference:
	  0x5211 through M4e (console only); 0x5212 from M5a (console + MIDI);
	  0x5213 from M5c (console + MIDI + audio out). Interim: pid.codes
	  1209:4440 is requested (pidcodes/pidcodes.github.com#1301).

config SP1_USB_MANUFACTURER
	string "USB manufacturer string"
	default "SP-1 community"

config SP1_USB_PRODUCT
	string "USB product string (the name hosts show for the device and its MIDI port)"
	default "Glag"
	help
	  "wakes-sp1" through v0.6.x; "Wakes" from M5c (Adara). DAWs remember MIDI routings by
	  port name, so a change means re-selecting the port once on each host.

config SP1_USB_MAX_POWER
	int "bMaxPower, in units of 2 mA"
	default 50
	range 0 250
	help
	  iOS rejects accessories claiming more than 100 mA over the camera adapter, and
	  the SP-1 runs from its own battery.

config SP1_AUDIO_BLOCK_FRAMES
	int "Audio block, in frames at 48 kHz"
	default 96
	range 48 240
	help
	  How much audio is rendered at a time: 96 = 2 ms (the default since #32; with 1 queued,
	  8 ms of latency), 240 = 5 ms (25 ms with 2 queued; v0.5.0). Must be a multiple of 48 (1 ms): whole
	  Plaits blocks, and whole 1 kHz groups for Marbles' X/Y. Latency is
	  (CONFIG_I2S_NRFX_TX_BLOCK_COUNT + 3) blocks -- see prj.conf.

config SP1_PLAITS_BLOCK
	int "Plaits block, in samples (12 or 24)"
	default 24
	range 12 24
	depends on SP1_PLAITS
	help
	  How many samples Plaits renders per call (upstream: 12). 24 (#32) halves Plaits'
	  per-call work and our per-Plaits-block glue; modulation, TRIG and MIDI placement move
	  to a 0.5 ms grid and Marbles runs at 2 kHz instead of 4. Every time constant of ours
	  that counted blocks (the TRIG pulse, Plaits' trigger delay, Additive's spectrum
	  update, Chords' crossfade, MIDI's clock and smoothing, Marbles' rate) is expressed in
	  time, so it is the same at either size. Only 12 and 24 are valid.

config SP1_TRIGGER_DELAY_SAMPLES
	int "Plaits' TRIG delay, in samples (whole Plaits blocks)"
	default 24
	range 0 96
	depends on SP1_PLAITS
	help
	  Upstream Plaits delays its TRIG input by 1 ms (48 samples) so a eurorack pitch CV
	  that lags its gate is still caught. In Wakes every TRIG arrives with its pitch, but
	  Plaits averages its V/Oct input over two blocks, so with no delay a Marbles X -> V/Oct
	  strike catches the pitch half-way (host: Modal's attack -1 dB from the settled one,
	  against -18 dB at 0.5 ms; MIDI notes and the quantizer latch are unaffected even at 0).
	  24 = 0.5 ms keeps every attack as it was (#32). Must be whole Plaits blocks.

config SP1_PROFILE_ICACHE
	bool "Diagnostics: flash-cache misses per audio section"
	default n
	depends on SP1_PLAITS
	help
	  Adds a BLK log line with the flash cache's misses per millisecond of audio, by
	  section (#32): whether 2 ms blocks cost more because of per-call work or because the
	  instruction cache refills each time the code switches between Marbles, MIDI and the
	  engine. Reads the NVMC counter a few times per Plaits block (~0.05 % CPU). Off in
	  release builds.

config SP1_STORAGE
	bool "eMMC storage: a FAT32 volume and its own thread (M6, #43)"
	default SP1_PLAITS
	select FILE_SYSTEM
	select FAT_FILESYSTEM_ELM
	select DISK_ACCESS
	help
	  The eMMC driver (src/sp1_emmc.c), FatFs on top of it, and a low-priority thread
	  that does all the work (src/sp1_store.h): below audio, main and USB, so it costs
	  the audio block nothing. Never formats -- that is SP1_FRESH alone. On in every
	  Plaits image (wakes-sp1, wakes-sp1-fresh); off in the fallback, the recovery image
	  that never touches the eMMC.

config SP1_STORAGE_TEST
	bool "Diagnostics: eMMC report and file test on every entry to ON (#43)"
	depends on SP1_STORAGE
	select INIT_STACKS            # the storage thread's stack headroom, in the report
	help
	  The card's identity, EXT_CSD and partition table (lines starting "EMMC"), then a
	  file test on the volume (lines starting "STORE"): a counter of ON entries that
	  survives power cycles and reflashes, 512 KB written in bursts, read back, compared
	  and deleted, free space and the WAKES directory. Off in release builds.

config SP1_EMMC_VERIFY
	bool "Diagnostics: read every eMMC write back and log any mismatch (#43)"
	depends on SP1_STORAGE
	help
	  Every written block is read straight back; a block that reads back wrong is logged
	  ("EMMC VERIFY FAIL": where in its burst, the card's token and busy, whether a slow
	  re-read agrees) and rewritten on its own. Halves write speed. Off in release builds.
	  (Built for the 2026-10-07 data hunt: every write verified; the fault was in burst
	  READS, src/sp1_emmc.c.)

config SP1_FRESH
	bool "wakes-sp1-fresh: FORMAT the eMMC on the first entry to ON (#43)"
	depends on SP1_STORAGE
	select FILE_SYSTEM_MKFS
	select FS_FATFS_EXTRA_NATIVE_API    # f_setlabel: the volume is labelled "SP-1"
	help
	  ⚠️ Erases the whole eMMC: one FAT32 partition from 4 MB, the build's ID written to
	  WAKES/FRESH.ID, never again while that file matches (src/sp1_store.h). A normal
	  build contains no formatter at all, and tools/ci/check_image.py fails one that does.

config SP1_DRIVE
	bool "Drive mode: the eMMC as a USB drive in STANDBY (#43)"
	depends on SP1_STORAGE
	default y
	select USBD_MSC_CLASS
	help
	  A USB mass-storage interface, always in the descriptor (so going STANDBY <-> ON
	  never re-enumerates and MIDI / audio are never disturbed). In STANDBY with a host
	  attached the card is the host's; turning ON takes it back -- the host then sees "no
	  medium" -- after any command already in progress finishes (src/sp1_store.h). The
	  interface goes LAST, after CDC, MIDI and audio, so their numbers do not move, and
	  bcdDevice changes (SP1_USB_BCD_DEVICE) because the function set did.

config SP1_USB_BCD_DEVICE
	hex "USB bcdDevice"
	default 0x0500 if SP1_DRIVE
	default 0x0403
	help
	  The device release number. 0x0403 is what Zephyr 4.3 put there by default
	  (USB_BCD_DRN) and every release through v0.7.2 shipped with it. One PID for good:
	  when the set of USB functions changes, this changes instead (M5c), so a host that
	  cached the old layout treats the device as new. 0x0500 = + the drive (M6).

# The drive's transfers: 16 blocks per disk call, so a host's large reads and writes become
# CMD18 / CMD25 bursts (sp1_emmc.h). 8 KB of RAM, only in drive builds.
config USBD_MSC_SCSI_BUFFER_SIZE
	default 8192 if SP1_DRIVE

config USBD_MSC_STACK_SIZE
	default 2048 if SP1_DRIVE

# ⚠️ Zephyr formats a volume it cannot mount unless told not to. The card arrives holding
# whatever an earlier firmware left there, so a failed mount must NEVER format: only
# SP1_FRESH formats, and only on purpose. These defaults come before Kconfig.zephyr's, so
# they win; check_image.py also fails an image built with MOUNT_MKFS on.
config FS_FATFS_MOUNT_MKFS
	default n

# Long file names (Adara, M6): presets are "<name>.prst", which 8.3 cannot hold, and samples
# will want readable names. ~0.5 KB of RAM for the name buffer (BSS mode), a few KB of flash;
# nothing in the audio path.
config FS_FATFS_LFN
	default y if SP1_STORAGE

config FS_FATFS_CUSTOM_MOUNT_POINT_COUNT
	default 1 if SP1_STORAGE

config FS_FATFS_CUSTOM_MOUNT_POINTS
	default "EMMC" if SP1_STORAGE

config SP1_LOGBUF_KB
	int "Stored log, in KB of RAM"
	default 16
	range 4 160
	help
	  Everything printk writes is also kept in RAM, newest last, and played back when a
	  terminal next opens the console -- so a session with the USB port in another host's
	  hands (the OP-XY) is not lost (src/sp1_logbuf.h). Since #52 the session also goes to
	  WAKES/LOGS/ on the drive every 5 s, so this only has to cover the gap between flushes
	  and the boot before the first ON: 16 KB, ~2 minutes of a session (96 KB before, and
	  still in an image without storage -- the fallback -- where RAM is all there is).

config SP1_USB_THREADS_BELOW_AUDIO
	bool "Run Zephyr's USB threads below the audio thread (#32)"
	default y
	depends on UDC_NRF_OUT_FAST
	help
	  Moves the udc_nrfx and usbd threads from K_PRIO_COOP(8), above audio, to main's
	  priority, so enumeration, the console and control requests cannot push an audio
	  block over (src/sp1_usbd.c). Only with the MIDI fast path: MIDI must not wait on
	  these threads, or its timestamps would be up to a block late.

config SP1_MIDI
	bool "USB-MIDI in: notes into Plaits, CCs onto both modules (M5a)"
	default y
	depends on SP1_PLAITS
	help
	  A USB-MIDI 1.0 port (feldd's class, third_party/feldd) next to the console.
	  Notes play Plaits, CCs offset parameters on both modules, all configured by
	  the MIDI script (config/midi.cnfg built in, WAKES/CNFG/midi.cnfg on the drive at
	  every ON). Costs nothing until a host sends something.
	  n: no MIDI function on the USB device at all.

config SP1_USB_AUDIO
	bool "USB audio out: the SP-1's output to the host, USB Audio Class 1.0 (M5c)"
	default y
	depends on SP1_PLAITS && UDC_NRF_ISO_IN_FAST
	help
	  The output the codecs get, after VOL, sent to the host as a 48 kHz 16-bit
	  stereo input (src/sp1_uac.c). Output only: nothing is received from the host.
	  Packets go out from the USB interrupt through the ISO IN fast path
	  (zephyr-patches/udc_nrf-fast-paths.patch), which is required. Costs nothing
	  until a host opens the stream.

config SP1_GLAG
	bool "Glag ambient engine as the audio source"
	default y
	depends on !SP1_PLAITS
	help
	  The Glag engine (../glag) renders the audio, and its controls (glag_ui) own the
	  faders, buttons and LEDs. Wakes' power, watchdog, standby, battery and audio
	  bring-up are used unchanged. n: Wakes' M2 test tone (the fallback).

config SP1_GLAG_NOIR_TEST
	bool "Diagnostics: the noir album as a CPU test"
	default n
	depends on SP1_GLAG_CPU_TEST
	help
	  The CPU test's logging and checks, without its scenario script: from power-on the noir
	  album plays (the seven noir songs, 2:30 each, in the C phrasing, a space piece of 1:15
	  between each two, the room held across each change). The audition pieces are carried
	  (GL_DEMO_PIECES); Haze reads the echo's tape (no room for its own memory).

config SP1_GLAG_CPU_TEST
	bool "Diagnostics: Glag's hardware test (v3): a scenario script with checks"
	default n
	depends on SP1_GLAG
	select INIT_STACKS            # each thread's stack headroom, after every scenario
	select THREAD_STACK_INFO
	help
	  A test build for Glag on the SP-1. It plays a script of 14 scenarios through the
	  controls (glag/glag_test.h, the same script its host twin host/hwtest.c plays): every
	  voice on all four channels, each reverb and echo time all the way up, freeze and slow,
	  every distortion, the textures, Playworld, the macros, the faders swept on every page,
	  MIDI floods, quick changes, the album and shuffle. About 15 minutes a round, then
	  round again (shuffle dealt anew). Each scenario ends with lines starting "GLAG T3 =":
	  the blocks' load (over 90, 100, 150, 200 %), the governor, what came out (peak, level,
	  DC, clipping, clicks, silence, NaN, the sample rate), the engine's counts (steps against
	  the tempo, notes, steals), the stream's failures, every thread's free stack and the
	  TX blocks left. After each AUD line a GLAG line gives the last 5 s by part, as before.
	  The script presses only FFWD and RWD, never ••, VOL or PLAY; any real button (VOL aside)
	  or a fader moved by a hand (more than 8 %, past its noise) stops it at once, and it
	  carries on 30 s after the last touch. A "GLAG win" line every 5 s gives that window's
	  late blocks, steals, clicks and silences, script running or not. The output is capped
	  6 dB under what VOL gives. Writes nothing anywhere.
	  Off in release builds.

config SP1_PLAITS
	bool "Plaits voice as the audio source (M3)"
	default n
	select CPP
	help
	  y: PLAY triggers the Plaits voice (2-op FM), faders are FREQUENCY /
	  TIMBRE / MORPH / HARMONICS, VOL+/- set the output level.
	  n: the M2 440 Hz test tone instead, with its PLAY / VOL controls, and
	  none of the Plaits code is compiled or linked.

	  This is the FALLBACK SWITCH. If the voice faults or overruns on hardware,
	  set CONFIG_SP1_PLAITS=n in prj.conf and rebuild: everything else in the
	  build (headphone mute, LEDs, power) stays exactly as it was.

config SP1_STRING_VOICES
	int "String engine: number of strings (Plaits kNumStrings)"
	range 1 3
	default 2
	depends on SP1_PLAITS
	help
	  How many strings Plaits' String engine rings at once. Upstream is 3.
	  Each TRIG plucks the next string round-robin, so this is how many
	  notes can overlap before the oldest one is re-plucked.

	  2 (default, M3e): every string costs the same, so 2 saves a third of
	  the engine -- 598.6 -> 427.3 instructions/sample in tools/plaits-bench,
	  about 90 % -> 65 % of the audio budget on the SP-1. At 3, String
	  measured 90 % average and 98.5 % peak: it played, with no headroom.

	  Applied at build time to a generated copy of string_engine.h; the
	  vendored file is not modified (see "Plaits overrides" in
	  firmware/CMakeLists.txt). Set it to 3 in prj.conf to A/B the original.

config SP1_PARTICLES
	int "Particle engine: number of particles (Plaits kNumParticles)"
	range 1 6
	default 2
	depends on SP1_PLAITS
	help
	  How many resonant "particles" Plaits' Particle engine runs. Upstream
	  is 6. Plaits divides the density by this count, so the rate of events
	  is the same; fewer means fewer pings ringing at different pitches at
	  once.

	  2 (default, M3h): at 3 (M3f) the SP-1 peaked at 83-100 %, all of it
	  below MORPH centre where the diffuser runs (Adara). Each particle is
	  ~43 instructions/sample. At 6 (upstream) it measured 86 % average /
	  97 % peak. The diffuser is skipped above MORPH centre in any case.

config SP1_MODAL_MODES
	int "Modal engine: number of resonator modes (Plaits kMaxNumModes)"
	range 4 24
	default 12
	depends on SP1_PLAITS
	help
	  Partials of Plaits' modal resonator. Upstream is 24. Must be a
	  multiple of 4 (the resonator renders modes in batches of 4; the build
	  checks). Fewer modes drop the highest partials: the body of a bell
	  stays, its shimmer goes.

	  12 (default, M3g): 8 measured 49 % average / 54 % peak on the SP-1
	  and sounded band-limited (Adara); each batch of 4 modes costs ~100
	  instructions/sample, ~16 %, so 12 is expected near 65 % / 70 %.
	  8 is the fallback. 16 would be ~80 % average -- over the target.

endmenu

source "Kconfig.zephyr"
```

## prj.conf
```kconfig
# wakes-sp1 M0 — the safety floor.
#
# Deliberately minimal. No USB, no console, no audio, no ADC. Every option
# here either keeps the device recoverable or is required to boot at all.
# Things are ADDED in later milestones, never removed to fix a build.

# ---- Recoverability ----
# The watchdog is the final backstop for a hang on a device with no reset pin.
CONFIG_WATCHDOG=y
# k_sys_fatal_error_handler() in main.c turns any fault into a cold reboot.
CONFIG_REBOOT=y

# ---- Fault containment ----
# HW_STACK_PROTECTION reprograms the MPU stack guard on every context switch.
# sp1-tape-looper measured that at ~1 % at the corner and turned it off in
# favour of the cheaper STACK_SENTINEL canary (which Kconfig excludes while
# MPU_STACK_GUARD is on). M0 has CPU to spare and no audio deadline yet, so
# keep the stronger guard here and revisit at M2 when the deadline is real.
CONFIG_HW_STACK_PROTECTION=y

# ---- USB CDC ACM console (M1c) ----
# Exists to make two things possible that are miserable blind: calibrating the
# battery divider, and building the button-ladder threshold tables in M1d.
#
# device_next rather than the legacy CONFIG_USB_DEVICE_STACK: legacy is smaller but
# deprecated, mass storage later would need device_next anyway, and this is the path
# sp1-tape-looper proved on this board and this Zephyr version.
CONFIG_CONSOLE=y
CONFIG_PRINTK=y
CONFIG_SERIAL=y
CONFIG_UART_CONSOLE=y
CONFIG_UART_LINE_CTRL=y
CONFIG_UART_INTERRUPT_DRIVEN=y

CONFIG_USB_DEVICE_STACK_NEXT=y
CONFIG_USBD_CDC_ACM_CLASS=y
# The app owns the single USBD context; do not let the CDC SYS_INIT build a second
# private one that would fight for the controller.
CONFIG_CDC_ACM_SERIAL_INITIALIZE_AT_BOOT=n
CONFIG_HWINFO=y
# The device's identity (VID/PID, names, bMaxPower) is CONFIG_SP1_USB_* in firmware/Kconfig
# since M5a, set by src/sp1_usbd.c rather than Zephyr's sample helper.

# ---- USB-MIDI (M5a) ----
# feldd's MIDI 1.0 class (third_party/feldd) queues its transmit side in a ring buffer.
CONFIG_RING_BUFFER=y
# #32: MIDI is received in the USB interrupt (zephyr-patches/udc_nrf-fast-paths.patch):
# ~110 us of thread hand-offs per message down to a few us, and stamped in the interrupt.
# That frees Zephyr's USB threads to run below audio (CONFIG_SP1_USB_THREADS_BELOW_AUDIO,
# on by default with it).
CONFIG_UDC_NRF_OUT_FAST=y
# M5c: USB audio out sends every packet from the USB interrupt (Ryan Gilmore's ISO IN fast
# path, same patch). CONFIG_SP1_USB_AUDIO (default y) needs it.
CONFIG_UDC_NRF_ISO_IN_FAST=y

CONFIG_LOG=n
CONFIG_ASSERT=n

# The USB stack's init and printf need more main stack than the bare power build.
# 3 KB from M3 (was 2 KB): main now uses the FPU (fader smoothing), so every exception
# taken on its stack carries the extended FP frame, and it calls printk with more args.
CONFIG_MAIN_STACK_SIZE=3072

# ---- Clocking ----
# Matches what the bootloader leaves behind. Do not change without reading
# docs/SAFETY.md -- re-initialising bootloader-owned clocks is on the "do not"
# list for this board.
CONFIG_CLOCK_CONTROL=y
CONFIG_CLOCK_CONTROL_NRF_K32SRC_SYNTH=y


# ---- LED rows on hardware PWM (M1a) ----
# Hardware PWM costs no CPU (EasyDMA), unlike the software PWM sp1-tape-looper
# uses -- which needed a zero-latency IRQ to stop flicker and would compete with
# the audio deadline from M2 on. Do not replace this with a software PWM.
CONFIG_PWM=y
CONFIG_PWM_NRFX=y

# ---- Battery voltage (M1b) ----
# SAADC on AIN4. Only the battery channel for now; the faders join in M1c.
CONFIG_ADC=y

# ---- Output naming ----
# Renames build/zephyr/zephyr.{elf,bin,hex,map,...} to wakes-sp1.{elf,bin,hex,map,...}.
# The build/zephyr/ subdirectory itself is unaffected -- that name comes from the
# Zephyr CMake target, not this option.
CONFIG_KERNEL_BIN_NAME="glag-sp1"

# ---- Audio output (M2) ----
# I2C to the two codecs (CS42L42 headphone at 0x48, TAS2505 speaker amp at 0x18),
# and the I2S stream as a CLOCK SLAVE on both clocks -- see sp1_audio.h for the
# topology. Same three options sp1-tape-looper proved on this board.
CONFIG_I2C=y
CONFIG_I2S=y
CONFIG_I2S_NRFX=y
# ---- latency (M5b, Adara: "over 30 ms is a no-go"; #32: 10 ms) ----
# Sound leaves Wakes (queued blocks + 3) x the block length after what caused it: one block
# to place a MIDI message on time, the queued blocks, the DMA's next one and the one
# playing (sp1_audio.c). 5 ms x 4 queued was 35 ms, 5 ms x 2 was 25 ms (v0.5.0), 2 ms x 2 was
# 10 ms, and 2 ms x 1 is 8 ms (#32), affordable since Plaits renders 24-sample blocks. The block
# length is CONFIG_SP1_AUDIO_BLOCK_FRAMES (firmware/Kconfig). What it costs: a block that runs
# long has (queued + 1) x 2 = 4 ms -- 200 % of its budget -- before the output runs dry. The
# heaviest session measured (Chords, Marbles, OUTxAUX, drive, a CC stream; 2026-10-04) peaked at
# 96.8 %, and USB enumeration no longer runs above audio.
CONFIG_I2S_NRFX_TX_BLOCK_COUNT=1

# ---- CPU per thread, for the log (M5b diagnostics; src/sp1_threads.h) ----
# The audio sections cannot see what preempts them -- the USB stack runs above audio -- so
# every thread's share is counted at each context switch, on the DWT cycle counter (the
# kernel's own tick would be 30 us coarse). A few cycles per switch.
CONFIG_THREAD_RUNTIME_STATS=y
CONFIG_THREAD_RUNTIME_STATS_USE_TIMING_FUNCTIONS=y
CONFIG_TIMING_FUNCTIONS=y
CONFIG_THREAD_MONITOR=y
CONFIG_THREAD_NAME=y

# Floating-point unit. Nothing in M2 uses float -- the tone and the meter are
# integer-only on purpose -- but Plaits is float throughout from M3. Turning the FPU
# on HERE means M3 changes one thing (the synth), not two (the synth and the
# FP context-switch behaviour).
CONFIG_FPU=y
# Preserve FP registers across context switches. CONFIG_FPU alone is Zephyr's
# UNSHARED mode: FP state is not saved when threads switch. Plaits (float) will run in
# the audio thread, and any float in main, USB or an ISR would silently corrupt it --
# and with the hard-float ABI the compiler may use VFP registers for plain data moves
# too. Set now, with the FPU, so M3 does not inherit a latent corruption bug.
CONFIG_FPU_SHARING=y

# ---- M3: the Plaits voice ----
# The fallback switch: n = the M2 test tone, and no Plaits code is built at all.
CONFIG_SP1_PLAITS=n
CONFIG_SP1_GLAG=y
# Plaits is C++ (no exceptions, no RTTI -- the Zephyr defaults) and needs <algorithm>
# and <cmath>, which the minimal C++ library does not provide.
# ⚠️ The audio thread runs at K_PRIO_PREEMPT(0) and MUST outrank main, so main moves
# to 1. From M3 the audio work is ~half the CPU; at equal priority the ADC scan and
# every printk would compete with the audio deadline. See sp1_audio.h.
CONFIG_MAIN_THREAD_PRIORITY=1
```

## cputest.conf
```kconfig
# The CPU test build: Glag's cost by part and the flash cache's misses after each AUD line, and a
# 30 s cycle through five CPU settings (Kconfig SP1_GLAG_CPU_TEST). Writes nothing anywhere.
#   west build -b stem_player SP-1-Glag/firmware/app -- -DBOARD_ROOT=$PWD/SP-1-Glag/firmware \
#     -DEXTRA_CONF_FILE=cputest.conf
CONFIG_SP1_GLAG_CPU_TEST=y
```

## noirtest.conf
```kconfig
# The noir album as a CPU test: the CPU test's logging and checks (GLAG sc=... by part, AUD, CPU)
# without its scenario script; from power-on the seven noir songs play (2:30 each, the C phrasing),
# a space piece of 1:15 between each two, the room held across each change. Writes nothing anywhere.
#   west build -b stem_player SP-1-Glag/firmware/app -- -DBOARD_ROOT=$PWD/SP-1-Glag/firmware \
#     -DEXTRA_CONF_FILE=noirtest.conf
CONFIG_SP1_GLAG_CPU_TEST=y
CONFIG_SP1_GLAG_NOIR_TEST=y
```

## src/sp1_audio.h
```c
/*
 * wakes-sp1 — audio output: codecs, 48 kHz I2S, output level, headphone detect, and
 * the block loop that runs the synth voice (M3) or the fallback test tone.
 *
 * ---- clock topology (TE's own, and the only one proven on this board) ----
 * The 3.072 MHz oscillator (P0.13) drives the I2S bit clock. The CS42L42 headphone
 * codec is the FRAME master: it divides that clock by 64 to make a frame clock of
 * exactly 48 000 Hz. The nRF52840 I2S peripheral and the TAS2505 speaker amp are both
 * CLOCK SLAVES. sp1-tape-looper found the hard way that having the nRF master the
 * clocks instead (at ~47 619 Hz) crackled on the speaker and gave only noise on the
 * headphones.
 *
 * ---- bring-up order, copied exactly from the proven path. DO NOT "TIDY" IT ----
 *   1. release both codec resets, 20 ms
 *   2. oscillator ON, 5 ms          -> the bit clock now exists
 *   3. start the I2S stream         -> nRF waits as a slave; there is no frame yet
 *   4. configure the TAS2505        -> its PLL locks to the BIT clock, already live
 *   5. configure the CS42L42        -> it starts mastering the FRAME clock, and the
 *                                      stream the nRF queued in step 3 begins to flow
 * Step 3 before step 5 looks backwards and is not: the amp only needs the bit clock,
 * the nRF just waits for frames, and this is the order that works on hardware.
 *
 * ---- priority: audio OUTRANKS main (M3) ----
 * Audio runs at K_PRIO_PREEMPT(0); CONFIG_MAIN_THREAD_PRIORITY=1 in prj.conf puts the
 * main loop below it. In M2 both were 0 and time-sliced (TIMESLICE_PRIORITY=0, 20 ms
 * slices), which was fine for a sine at ~7 % of the CPU and not for Plaits at ~50 %:
 * a 430 us ADC scan or a printk stalled by the host could then sit in front of an
 * audio block. Now the audio thread takes the CPU whenever a block is due, and main
 * runs in the gaps.
 *
 * ---- and therefore the audio thread must NEVER spin ----
 * The main loop is what feeds the watchdog and runs power-off. A thread that spins
 * ABOVE it starves both.
 *
 * What an OVERRUN does (voice slower than real time) -- checked against the pinned
 * i2s_nrfx.c, and not what an earlier version of this comment claimed: the driver
 * misses a buffer ("next buffers not supplied"), the stream goes to I2S_STATE_ERROR,
 * i2s_write() then fails at once, and the write-failure path SLEEPS 2 ms per failure
 * and re-primes after 8. So main still gets time: the device stays up with broken,
 * stuttering audio and a slower control loop, and power-off keeps working. It does
 * NOT starve into a watchdog reset -- so when debugging an overrun in M4, look for
 * `fail`/`rst` climbing on the AUD line, not for a reboot. CONFIG_SP1_PLAITS=n builds
 * the known-good tone firmware.
 *
 * tape-looper's write-failure path does `free; continue` with no sleep, which spins if
 * writes fail instantly. Every path through this thread blocks or sleeps instead. See
 * sp1_audio.c.
 *
 * ---- start/stop are bounded, always ----
 * sp1_audio_stop() is on the POWER-OFF path (sp1_quiesce_peripherals calls it). It
 * never waits more than 50 ms for the thread, whatever state the thread is in, and
 * power-off proceeds regardless -- rule 5a: power-off does not depend on anything
 * else succeeding.
 */
#ifndef SP1_AUDIO_H
#define SP1_AUDIO_H

#include <stdint.h>
#include <stdbool.h>

/* Create the audio thread (it parks immediately) and enable the DWT cycle counter.
 * Once, at boot, after the power-on gate. Safe to call stop() before this. */
void sp1_audio_init(void);

/* Bring the audio path up: resets released, oscillator on, stream started, both
 * codecs configured. Call on every entry to ON -- the way into STANDBY powers all of
 * it down. Bounded: never blocks longer than ~1 s, feeds the watchdog while it waits.
 * Returns 0 on success, negative if the stream could not be started. */
int sp1_audio_start(void);

/* Stop the stream. On the power-off path: waits at most 50 ms for the thread, then
 * returns REGARDLESS. Safe to call when audio was never started. */
void sp1_audio_stop(void);

/* Halt the I2S peripheral at register level and disconnect its pins. ONLY on the way
 * to SYSTEM_OFF -- never STANDBY, because the driver applies its pinctrl once at boot
 * and would not restore the pins. See sp1_audio.c. */
void sp1_audio_halt_for_system_off(void);

/* Peak |sample| (0..32767) of everything produced since the last call, then reset.
 * For the meter. Lock-free: one atomic swap. */
uint32_t sp1_audio_take_peak(void);

/* ---- OUTPUT LEVEL (VOL+ / VOL-) ----
 * 3 dB steps, slewed in the audio path so a change never clicks. Step 0 = 0 dBFS; the
 * last step is mute. Every TWO steps is one meter band (6.02 dB). Applies to the synth
 * and to the fallback tone alike, and to speaker and headphones alike -- the speaker's
 * extra speaker trim is separate and fixed (SP1_SPK_ATTEN_HALF_DB in sp1_audio.c:
 * -9 dB in M3, -6 dB since M4a). */
#define SP1_LEVEL_STEPS     12      /* 0 .. 10 = 0 .. -30 dB, 11 = mute */
#if defined(CONFIG_SP1_PLAITS)
#define SP1_LEVEL_DEFAULT    2      /* -6 dBFS                                */
#else
#define SP1_LEVEL_DEFAULT    4      /* -12 dBFS for the test tone, as in M2   */
#endif

void sp1_audio_level_step(int delta);  /* +1 = quieter by 3 dB, -1 = louder */
int  sp1_audio_level_get(void);

#if defined(CONFIG_SP1_USB_AUDIO)
/* #52: the audio settings from the drive (audio.cnfg). Main, at ON entry. sp1_audio_config()
 * is the live copy (the built-in one until then). */
struct sp1_audio_cfg;
void sp1_audio_set_config(const struct sp1_audio_cfg *c);
const struct sp1_audio_cfg *sp1_audio_config(void);
#endif
int  sp1_audio_level_db_x10(void);     /* tenths of dBFS, -9990 = mute      */

/* ---- the fallback test tone (CONFIG_SP1_PLAITS=n only): 440 Hz, off at start ---- */
void sp1_audio_tone_set(bool on);
bool sp1_audio_tone_on(void);

/* ---- headphone detect -> speaker mute (M3), and the USB audio mute (M5c) ----
 * Call from the main loop every tick while ON, after sp1_audio_start(). Polls the
 * CS42L42 jack sense every 40 ms, debounced, and powers the speaker down while a plug
 * is in -- or while a host is taking USB audio out (stream open AND packets flowing).
 * Headphones always play. Returns -1
 * (nothing new), 0 (unplugged), 1 (plugged), 2 (detect failed repeatedly: disabled for
 * this session, speaker ON -- the USB mute with it), 3 (a host started taking USB audio:
 * speaker off) or 4 (no host is taking it any more: speaker back on, unless headphones
 * are in). */
int sp1_audio_jack_poll(uint32_t elapsed_ms);
int sp1_audio_jack_state(void);        /* 1 in, 0 out, -1 unknown */
bool sp1_audio_speaker_on(void);       /* what the speaker amp is actually set to */

/* Block cost since the last call: worst and mean cycles per block. Read-and-clear. */
void sp1_audio_take_cycles(uint32_t *max, uint32_t *avg);

/* Where the blocks since the last call went (issue #22): mean and worst cycles per block
 * for each section, and how often the whole block ran over. Read-and-clear, like
 * sp1_audio_take_cycles(), and meant to be read in the same place.
 *
 *   ENG / MRB / POST   sp1_synth.h's sections
 *   RTE                the rest of sp1_synth_render(): Marbles -> Plaits routing, TRIG
 *   OUT                the rest of the block: gain ramp, stereo copy, meter peak
 *
 * `over` counts blocks that cost more than the budget; `over_run` is the longest run of
 * them in a row. A long run is what starves the main loop -- one late block is absorbed
 * by the I2S queue, a second of them is not. */
enum {
	SP1_SEC_ENG, SP1_SEC_MRB, SP1_SEC_RTE, SP1_SEC_POST, SP1_SEC_OUT, SP1_SEC_N
};
struct sp1_audio_sections {
	uint32_t avg[SP1_SEC_N];
	uint32_t max[SP1_SEC_N];
	uint32_t over;
	uint32_t over_run;
	/* #32: the once-per-audio-block part of rte (sp1_synth.h, `pre`), avg/max cycles. */
	uint32_t pre_avg, pre_max;
	uint32_t pre_midi_avg, pre_route_avg;   /* #32 B1: parts of pre, avg cycles */
	/* #32, CONFIG_SP1_PROFILE_ICACHE (zeros otherwise): flash-cache misses SUMMED over the
	 * window per section (index SP1_SEC_*; rte excludes pre, which is miss_pre), the blocks
	 * they came from, and the cache's own totals for every thread (NVMC IHIT / IMISS). */
	uint32_t miss[SP1_SEC_N];
	uint32_t miss_pre;
	uint32_t blocks;
	uint32_t icache_hit, icache_miss;
	/* #32: the slowest single engine call in the window (cycles), its Plaits engine, and
	 * whether it was the first call after an engine change. */
	uint32_t eng_worst;
	uint8_t eng_worst_engine;
	bool eng_worst_first;
};
void sp1_audio_take_sections(struct sp1_audio_sections *out);

/* ---- diagnostics ---- */
struct sp1_audio_stats {
	uint32_t blocks;         /* blocks handed to I2S                         */
	uint32_t write_fails;    /* i2s_write errors                             */
	uint32_t restarts;       /* stream drop + re-prime after repeated fails  */
	uint32_t tx_lost;        /* TX blocks the driver never gave back (found at a (re)start) */
	uint32_t tx_rebuilt;     /* times the TX pool was rebuilt for them       */
	uint32_t cyc_max;        /* worst cycles spent generating one block      */
	uint32_t cyc_budget;     /* cycles available per block                   */
	int      cfg_rc;         /* last i2s_configure() result                  */
	bool     running;
	bool     tas_ok;         /* every TAS2505 write ACKed                    */
	bool     hp_ok;          /* CS42L42 identified and configured            */
};
void sp1_audio_stats(struct sp1_audio_stats *out);
#if defined(CONFIG_SP1_GLAG)
/* Glag's album and shuffle fades (gl_ui_out.fade), 0..1, taken by the next block. VOL stays
 * the output level; until this the device ignored the fades (they were only in the controls'
 * own volume, which the device does not use) and the album cut from track to track. */
void sp1_audio_glag_fade(float g);
#endif
#if defined(CONFIG_SP1_GLAG_CPU_TEST)
/* The test build: the TX blocks free now, the fewest free since the last call, how many there are. */
void sp1_audio_t3_slab(uint32_t *free_now, uint32_t *free_min, uint32_t *total);
#endif

#endif /* SP1_AUDIO_H */
```

## src/sp1_console.c
```c
/*
 * wakes-sp1 — USB CDC ACM console. See sp1_console.h.
 *
 * Uses Zephyr's device_next USB stack, the path chattock/sp1-tape-looper proved on this
 * board and this Zephyr version. The legacy CONFIG_USB_DEVICE_STACK is smaller but
 * deprecated. Since M5a the USB device itself -- identity, every function on it -- is
 * sp1_usbd.c; this file is only the CDC ACM console that rides on it.
 */
#include "sp1_console.h"
#include "sp1_batt.h"
#include "sp1_power.h"
#include "sp1_controls.h"

#include <zephyr/kernel.h>
#include <zephyr/device.h>
#include <zephyr/drivers/uart.h>
#include "sp1_usbd.h"
#include "sp1_logbuf.h"
#include <zephyr/app_version.h>   /* generated from firmware/VERSION */

static bool up;

/* The console device itself, so DTR can be watched. */
static const struct device *cdc = DEVICE_DT_GET(DT_CHOSEN(zephyr_console));

/* ---- why the banner is stored rather than just printed ----
 * Printing it once at boot loses it. USB enumeration takes hundreds of
 * milliseconds and the host may not open the port for seconds after that, so the
 * banner goes out before anyone can receive it -- confirmed on hardware
 * 2026-09-20, where a capture showed nine buffered STATUS lines flushed on attach
 * but no banner. We cannot wait for a host either: the device has to boot
 * unplugged.
 *
 * So: keep the contents, and re-print them whenever DTR rises, i.e. whenever a
 * terminal attaches. Attaching minutes later still tells you why the device last
 * booted. */
static struct {
	uint32_t resetreas;
	uint32_t fault_reason;
	uint32_t fault_pc;
	bool     had_fault;
	bool     valid;
} boot_info;

static bool dtr_prev;

static void print_banner(void)
{
	printk("\n=== Glag v" APP_VERSION_STRING " (on Wakes' SP-1 base) ===\n");
	printk("built %s %s\n", __DATE__, __TIME__);

	/* nRF52840 POWER.RESETREAS -- ALL documented bits.
	 *
	 * An earlier version decoded only 0-3 and 16, and so printed no reason at
	 * all for 0x00100000 (bit 20, VBUS) -- which is the most common wake of all
	 * on this device: plugging in USB while off. A reset-reason decoder that is
	 * silent about the usual case is worse than none, because it reads as an
	 * unrecognised value. Keep this complete. */
	printk("resetreas 0x%08x%s%s%s%s%s%s%s%s%s\n", boot_info.resetreas,
	       (boot_info.resetreas & (1u << 0))  ? " pin"      : "",
	       (boot_info.resetreas & (1u << 1))  ? " watchdog" : "",
	       (boot_info.resetreas & (1u << 2))  ? " soft"     : "",
	       (boot_info.resetreas & (1u << 3))  ? " lockup"   : "",
	       (boot_info.resetreas & (1u << 16)) ? " off-wake:button" : "",
	       (boot_info.resetreas & (1u << 17)) ? " off-wake:lpcomp" : "",
	       (boot_info.resetreas & (1u << 18)) ? " debug-if" : "",
	       (boot_info.resetreas & (1u << 19)) ? " off-wake:nfc" : "",
	       (boot_info.resetreas & (1u << 20)) ? " off-wake:usb"  : "");
	if (boot_info.resetreas == 0u) {
		/* Cleared every boot, so an all-zero value means a genuine cold
		 * start: battery inserted, or the bootloader handed off without a
		 * recorded cause. */
		printk("          (cold start / no recorded cause)\n");
	}

	if (boot_info.had_fault) {
		printk("!! previous boot FAULTED: reason %u pc 0x%08x\n",
		       boot_info.fault_reason, boot_info.fault_pc);
	}
	printk("usb  %s\n", sp1_usb_present() ? "present" : "absent");
	printk("-----------------\n");
}

/* Status cadence, set per state by the loops. 0 disables status lines. */
static uint32_t status_period_ms = 1000u;

/* ---- raw control capture (M1d-a) ----
 * ~20 Hz is fast enough to catch a press and see a fader sweep as a curve, and slow
 * enough to stay readable. Deliberately a firehose; off by default.
 *
 * 48 ms, not 50: the control tick is 8 ms, so an accumulator threshold of 50 fires on
 * the 7th tick and the real period is 56 ms. 48 is exactly 6 ticks, which makes the
 * `t=` column advance in a clean 48 ms step and the cadence match what is printed in
 * the header instead of being 12 % slower than advertised. */
static bool     raw_capture;
static uint32_t raw_acc;
static uint32_t raw_lines;
#define RAW_PERIOD_MS  48u
#define RAW_HEADER_EVERY 40u    /* re-print the legend so a long capture stays readable */

static void print_raw_legend(void)
{
	printk("# t=uptime_ms  lad0,lad1=ladder ADC  f1..f4=fader ADC (0-4095)"
	       "  rail: i=idle L=loaded\n");
	printk("# f1..f4 ARE ONLY MEANINGFUL ON rail=i LINES."
	       " On rail=L a button is down and the fader rail is sagging.\n");
}

void sp1_console_set_raw_capture(bool on)
{
	raw_capture = on;
	raw_acc = 0u;
	raw_lines = 0u;
	if (up && on) {
		printk("\n--- RAW CAPTURE ON (%u ms / %u Hz) ---\n",
		       RAW_PERIOD_MS, 1000u / RAW_PERIOD_MS);
		print_raw_legend();
		printk("# battery STATUS lines are suppressed while this is on,"
		       " so the capture stays one thing.\n");
	} else if (up) {
		printk("\n--- RAW CAPTURE OFF ---\n");
	}
}

bool sp1_console_raw_capture(void)
{
	return raw_capture;
}

void sp1_console_set_status_period(uint32_t ms)
{
	status_period_ms = ms;
}

/* ---- why anything long has to be paced ----
 * CDC ACM has a finite ring buffer and printk does not block waiting for the host
 * to drain it: past the end of the buffer, characters are simply DROPPED. A burst
 * of forty lines emitted inside one control tick overruns it.
 *
 * Observed on hardware 2026-09-19: the calibration report came out shredded
 * mid-line -- `{  209, "T1	{  399, "T2" },` -- and the boot banner in the same log
 * is cut at `lvl=25`. Both are the same overrun. It is a nasty failure because the
 * output looks almost right, so it reads as a formatting bug rather than as data
 * loss, and a table transcribed from it would be silently wrong.
 *
 * sp1_console_pace() yields the CPU briefly so the USB stack can move a packet.
 * Every multi-line dump must call it between lines. It is only safe from the
 * control loop -- never from the audio path once M2 lands. */
void sp1_console_pace(void)
{
	if (!up) {
		return;
	}
	/* One tick is enough: CDC ACM moves a 64-byte packet per USB frame (1 ms) and
	 * a line here is well under that. Two ticks would double a 40-line report's
	 * duration for no benefit. */
	k_msleep(1);
}

int sp1_console_init(void)
{
	if (sp1_usbd_init() != 0) {
		return -1;
	}
	up = true;
	/* Deliberately NOT waiting for DTR: the device must boot unplugged. Output
	 * before a host attaches is simply dropped. */
	return 0;
}

void sp1_console_banner(uint32_t resetreas, bool had_fault,
			uint32_t fault_reason, uint32_t fault_pc)
{
	boot_info.resetreas    = resetreas;
	boot_info.had_fault    = had_fault;
	boot_info.fault_reason = fault_reason;
	boot_info.fault_pc     = fault_pc;
	boot_info.valid        = true;

	if (!up) {
		return;
	}
	/* Print it now in case a host is already listening, and again on every DTR
	 * rise (see sp1_console_poll). Either may be the one that lands. */
	print_banner();
}

void sp1_console_poll(uint32_t elapsed_ms, const char *state)
{
	static uint32_t acc;
	static bool     announced_complete;

	if (!up) {
		return;
	}

	/* Re-print the banner whenever a terminal attaches. DTR rising is the host
	 * opening the port; the boot banner printed before that was almost certainly
	 * lost. Non-blocking: if DTR cannot be read we simply never re-print. */
	if (cdc != NULL && device_is_ready(cdc)) {
		uint32_t dtr = 0;
		if (uart_line_ctrl_get(cdc, UART_LINE_CTRL_DTR, &dtr) == 0) {
			const bool now = (dtr != 0);
			if (now && !dtr_prev) {
				/* The banner again (not stored twice), then everything stored
				 * since boot -- an OP-XY session, a stretch on battery
				 * (sp1_logbuf.h). */
				if (boot_info.valid) {
					sp1_logbuf_hold(true);
					print_banner();
					sp1_logbuf_hold(false);
				}
				sp1_logbuf_replay_start();
			} else if (!now && dtr_prev) {
				sp1_logbuf_replay_stop();   /* nobody is listening any more */
			}
			dtr_prev = now;
		}
	}
	/* The stored log, a step per tick: paced for CDC ACM, and the loop goes on feeding
	 * the watchdog in between. */
	sp1_logbuf_replay_step();

	if (raw_capture) {
		raw_acc += elapsed_ms;
		if (raw_acc >= RAW_PERIOD_MS) {
			raw_acc = 0u;
			char line[96];
			if (sp1_controls_raw_line(line, sizeof(line)) > 0) {
				if (raw_lines % RAW_HEADER_EVERY == 0u) {
					print_raw_legend();
				}
				raw_lines++;
				printk("%s\n", line);
			}
		}

		/* ---- the capture owns the console while it runs ----
		 * Interleaving a battery STATUS line into a 20 Hz control capture
		 * every few seconds makes the capture unreadable exactly when you are
		 * trying to correlate lines against what your hands were doing. Adara
		 * asked for the control log to be the fast one and the battery to stay
		 * slow; the clean way to get that is for the slow one to stand down
		 * entirely rather than to race.
		 *
		 * Nothing is lost that matters: the battery is still SAMPLED on its own
		 * 10 s timer, so voltage and charge state stay current -- this
		 * suppresses the print, not the read -- and the boot banner is above
		 * this return, so a terminal attaching mid-capture still learns why the
		 * device booted.
		 *
		 * The CALIBRATION line is below it and is therefore also suppressed.
		 * That is fine and deliberate: the divider was measured in M1c and
		 * SP1_BATT_DIVIDER_MILLI is populated, so that line has no job left. If
		 * you ever need to re-measure it, turn the capture off -- the two
		 * calibrations were never meant to run at the same time. */
		return;
	}

	if (status_period_ms == 0u) {
		return;      /* status lines off; banner and calibration still ran */
	}
	acc += elapsed_ms;
	if (acc < status_period_ms) {
		return;
	}
	acc = 0u;

	const bool plugged  = sp1_usb_present();
	const bool charging = sp1_charging();

	printk("[%s] batt raw=%4u  %umV  lvl=%3u/255   usb=%d chg=%d\n",
	       state, sp1_batt_raw(), sp1_batt_mv(), sp1_batt_level(),
	       plugged ? 1 : 0, charging ? 1 : 0);

	/* ---- the calibration line ----
	 * The BQ24232 terminates at 4.20 V, and says so: nPGOOD low (USB good) with
	 * nCHG high (not charging) means charge complete, so the cell is at 4.20 V
	 * BY DEFINITION. That pins the unknown divider:
	 *
	 *     V_adc   = raw / 4095 * 3.6 V
	 *     divider = 4.20 / V_adc
	 *
	 * Printed continuously while complete rather than on the transition, because
	 * plugging in an already-full battery produces no transition to catch. */
	if (plugged && !charging && sp1_batt_valid()) {
		const uint32_t raw = sp1_batt_raw();
		if (raw > 0u) {
			/* divider x1000 = 4200 * 1000 * 4095 / (raw * 3600).
			 * Written as 4777500 / raw: the naive form overflows uint32
			 * (4200 * 1000 * 4095 = 1.72e10 against a 4.29e9 ceiling).
			 * 4200 * 4095 / 3600 = 4777.5, so x1000 gives 4777500. */
			const uint32_t div_milli = 4777500u / raw;
			printk("CALIBRATION  charge complete: raw=%u"
			       "  ==> divider = %u.%03u  (currently assuming %u.%03u)\n",
			       raw, div_milli / 1000u, div_milli % 1000u,
			       SP1_BATT_DIVIDER_MILLI / 1000u,
			       SP1_BATT_DIVIDER_MILLI % 1000u);
			if (!announced_complete) {
				announced_complete = true;
				printk("CALIBRATION  put this in"
				       " SP1_BATT_DIVIDER_MILLI (sp1_batt.h)"
				       " as an integer x1000, and rebuild.\n");
			}
		}
	} else {
		announced_complete = false;
	}
}
```
